## boards/shields/nrf54h20_sensor_board/Kconfig.shield
```kconfig
#
# Copyright (c) 2024 Nordic Semiconductor ASA
#
# SPDX-License-Identifier: LicenseRef-Nordic-5-Clause
#
config SHIELD_NRF54L15_SENSOR_BOARD
	def_bool $(shields_list_contains,nrf54l15_sensor_board)
```

## samples/nrf5340/multicore/Kconfig.sysbuild
```kconfig
#
# Copyright (c) 2023 Nordic Semiconductor ASA
#
# SPDX-License-Identifier: LicenseRef-Nordic-5-Clause
#

source "share/sysbuild/Kconfig"

config MULTICORE_REMOTE_BOARD
	string "The board used for remote target"
	default CONFIG_DOMAIN_CPUNET_BOARD if SOC_NRF5340_CPUAPP
```

## subsys/event_manager_proxy/Kconfig
```kconfig
#
# Copyright (c) 2022 Nordic Semiconductor
#
# SPDX-License-Identifier: LicenseRef-Nordic-5-Clause
#

config EVENT_MANAGER_PROXY
	depends on EVENT_MANAGER
	bool "Event manager proxy"
	depends on IPC_SERVICE
	select EVENTS
	select EVENT_MANAGER_PROVIDE_EVENT_SIZE
	select EVENT_MANAGER_POSTPROCESS_HOOKS
	help
	  Event manager proxy would take care of passing the events between the different cores.

#if EVENT_MANAGER_PROXY

config EVENT_MANAGER_PROXY_CH_COUNT
	int "Number of IPC instances to be used"
	range 1 32
	default 1
	help
	  Number of the communication channels to be supported.
	  It covers the information with how many cores we wish to communicate.

config EVENT_MANAGER_PROXY_BOND_TIMEOUT_MS
	int "Timeout while waiting for the endpoint to bond in ms"
	range 1 1000
	default 100
	help
	  Timeout when waiting for endpoint bonding.
	  This timeout depends on the time to initialize all the cores
	  the event proxy manager is going to communicate.

config EVENT_MANAGER_PROXY_RSP_TIMEOUT_MS
	int "Timeout while waiting for command response"
	range 1 100
	default 10
	help
	  The time given for the event manager proxy on another core
	  to process the command.

#endif # EVENT_MANAGER_PROXY
```
