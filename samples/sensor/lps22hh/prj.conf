## CMakeLists.txt
```
#
# Copyright (c) 2023 Nordic Semiconductor
#
# SPDX-License-Identifier: LicenseRef-Nordic-5-Clause
#

cmake_minimum_required(VERSION 3.20.0)

find_package(Zephyr REQUIRED HINTS $ENV{ZEPHYR_BASE})
project(lps22hh)

FILE(GLOB app_sources src/*.c)
# NORDIC SDK APP START
target_sources(app PRIVATE ${app_sources})
# NORDIC SDK APP END
```

## sample.yaml
```
sample:
  name: LPS22HH Sensor Sample
tests:
  sample.sensor.lps22hh.nrf54h20_sensor_board:
    integration_platforms:
      - nrf54h20dk_nrf54h20_cpuapp
    platform_allow: >-
      nrf54h20dk_nrf54h20_cpuapp
    tags: sensors
    extra_args: SHIELD="nrf54h20_sensor_board"
```

## prj.conf
```kconfig
#
# Copyright (c) 2023 Nordic Semiconductor
#
# SPDX-License-Identifier: LicenseRef-Nordic-5-Clause
#

CONFIG_SENSOR=y
CONFIG_SENSOR_INFO=y

CONFIG_LPS22HH=y

# LPS22 driver uses GPIO
CONFIG_GPIO=y

# Enable UART console
CONFIG_SERIAL=y
CONFIG_CONSOLE=y
CONFIG_UART_CONSOLE=y
CONFIG_UART_ASYNC_API=y

# Logger configuration
CONFIG_LOG=y
CONFIG_LOG_BACKEND_UART=y

CONFIG_ASSERT=y
CONFIG_REBOOT=y
CONFIG_FPU=y
```

## src/main.c
```c
/*
 * Copyright (c) 2024 Nordic Semiconductor ASA.
 *
 * SPDX-License-Identifier: LicenseRef-Nordic-5-Clause
 */


#include <zephyr/kernel.h>
#include <zephyr/device.h>
#include <zephyr/drivers/sensor.h>
#include <stdio.h>
#include <zephyr/sys/__assert.h>



static K_SEM_DEFINE(sem, 0, 1);

static void trigger_handler(const struct device *dev,
			    const struct sensor_trigger *trigger)
{
	ARG_UNUSED(dev);
	switch (trigger->type) {
	case SENSOR_TRIG_DATA_READY:
		printk("Data ready trigger\r\n");
		break;
	default:
		printk("Unknown trigger event %d\r\n", trigger->type);
		break;
	}
	k_sem_give(&sem);
}


int main(void)
{
	const struct device *dev = DEVICE_DT_GET_ANY(st_lps22hh);

	if (IS_ENABLED(CONFIG_LOG_BACKEND_RTT)) {
		/* Give RTT log time to be flushed before executing tests */
		k_sleep(K_MSEC(500));
	}

	if (!device_is_ready(dev)) {
		printk("Sensor device not ready\n");
		return 0;
	}

	printk("device is %p, name is %s\n", dev, dev->name);

	return 0;
}
```
